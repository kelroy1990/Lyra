## APP/Lyra/sdkconfig.defaults
```kconfig
# C++ exceptions required by cspot (LoginBlob, Session, etc. throw on errors)
# Without this, __cxa_allocate_exception is wrapped to call abort() by ESP-IDF
CONFIG_COMPILER_CXX_EXCEPTIONS=y
CONFIG_COMPILER_CXX_EXCEPTIONS_EMG_POOL_SIZE=0

# PSRAM allocation threshold: only objects < 1 KB go to internal SRAM by default.
# Objects >= 1 KB (task stacks, lwIP bufs, TinyUSB SW buf, cspot heap, etc.) use PSRAM.
# DMA-critical paths still use MALLOC_CAP_INTERNAL|DMA explicitly — unaffected.
# Reduces SRAM fragmentation and leaves more contiguous DMA SRAM headroom.
# Was 16384 (16 KB): caused large buffers to fragment internal SRAM unnecessarily.
CONFIG_SPIRAM_MALLOC_ALWAYSINTERNAL=1024
```
